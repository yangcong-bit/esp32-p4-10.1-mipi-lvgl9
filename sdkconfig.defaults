## sdkconfig.defaults
```kconfig
# WTDKP4C5-S1 开发板 sdkconfig 默认配置
# 基于 ESP32-P4 (Eco2 预量产版) + 10.1寸 IPS 屏幕 (JD9366)

# ---- 芯片版本 (Eco2 预量产版，版本 < 3.0) ----
CONFIG_ESP32P4_SELECTS_REV_LESS_V3=y

# ---- Flash 配置 ----
CONFIG_ESPTOOLPY_FLASHMODE_QIO=y
CONFIG_ESPTOOLPY_FLASHFREQ_80M=y

# ---- Flash 大小 ----
CONFIG_ESPTOOLPY_FLASHSIZE_16MB=y
CONFIG_ESPTOOLPY_FLASHSIZE="16MB"

# ---- PSRAM (帧缓冲区需要，MIPI DSI 需要 200MHz 高带宽) ----
CONFIG_SPIRAM=y
CONFIG_SPIRAM_MODE_QUAD=y
CONFIG_SPIRAM_SPEED_250M=y
CONFIG_SPIRAM_XIP_FROM_PSRAM=y
CONFIG_CACHE_L2_CACHE_256KB=y
CONFIG_CACHE_L2_CACHE_LINE_128B=y

# ---- LVGL 性能解锁优化 ----
CONFIG_LV_USE_CLIB_MALLOC=y
CONFIG_LV_USE_CLIB_STRING=y
CONFIG_LV_USE_CLIB_SPRINTF=y
CONFIG_LV_DRAW_SW_DRAW_UNIT_CNT=2
CONFIG_LV_ATTRIBUTE_FAST_MEM_USE_IRAM=y
CONFIG_LV_DEF_REFR_PERIOD=33


# ---- I2C (触摸总线) ----
CONFIG_I2C_MASTER_ISR_HANDLER_IN_IRAM=y

# ---- LVGL 配置 ----
CONFIG_LV_COLOR_DEPTH_24=y
CONFIG_LV_USE_PERF_MONITOR=y
CONFIG_LV_FONT_MONTSERRAT_28=y

# ---- ESP Timer ----
CONFIG_ESP_TIMER_TASK_STACK_SIZE=8192

# ---- 调试 (可选，正式时关闭) ----
# CONFIG_LOG_DEFAULT_LEVEL_DEBUG=y

# ---- Watchdog Configs ----
CONFIG_ESP_TASK_WDT_TIMEOUT_S=15
CONFIG_TASK_WDT_TIMEOUT_S=15
CONFIG_ESP_TASK_WDT_CHECK_IDLE_TASK_CPU0=n
CONFIG_ESP_TASK_WDT_CHECK_IDLE_TASK_CPU1=n
CONFIG_TASK_WDT_CHECK_IDLE_TASK_CPU0=n
CONFIG_TASK_WDT_CHECK_IDLE_TASK_CPU1=n
```
